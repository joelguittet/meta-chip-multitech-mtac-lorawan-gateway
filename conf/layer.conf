## conf/layer.conf
```bitbake
# We have a conf and classes directory, append to BBPATH
BBPATH .= ":${LAYERDIR}"

# We have a recipes directory, add to BBFILES
BBFILES += "${LAYERDIR}/recipes*/*/*.bb ${LAYERDIR}/recipes*/*/*.bbappend"

BBFILE_COLLECTIONS += "meta-chip-multitech-mtac-lorawan-gateway"
BBFILE_PATTERN_meta-chip-multitech-mtac-lorawan-gateway := "^${LAYERDIR}/"
BBFILE_PRIORITY_meta-chip-multitech-mtac-lorawan-gateway = "15"
```
